## src/drivers/fuelcell_serial/Kconfig
```kconfig
menuconfig DRIVERS_FUELCELL_SERIAL
	bool "fuelcell_serial"
	default n
	---help---
		Enable support for fuel cell serial telemetry driver
```

## src/drivers/pcu_serial/Kconfig
```kconfig
menuconfig DRIVERS_PCU_SERIAL
	bool "pcu_serial"
	default n
	---help---
		Enable support for PCU (Power Control Unit) serial telemetry driver
```
